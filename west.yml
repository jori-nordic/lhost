## west.yml
```yaml
manifest:
  projects:
    - name: zephyr
      url: https://github.com/zephyrproject-rtos/zephyr
      revision: d7223e7bba84b3395a695c8371b117f91ba9b771
      import:
        name-allowlist:
          - hal_nordic
          - tinycrypt
          - nrf_hw_models
```
